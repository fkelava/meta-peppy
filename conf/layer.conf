## conf/layer.conf
```bitbake
# We have a conf and classes directory, add to BBPATH
BBPATH .= ":${LAYERDIR}"

# We have recipes-* directories, add to BBFILES
BBFILES += "${LAYERDIR}/recipes-*/*/*.bb \
            ${LAYERDIR}/recipes-*/*/*.bbappend"

BBFILE_COLLECTIONS += "meta-peppy"
BBFILE_PATTERN_meta-novatec = "^${LAYERDIR}/"
BBFILE_PRIORITY_meta-novatec = "10"

LAYERDEPENDS_meta-peppy = "core"
LAYERSERIES_COMPAT_meta-peppy = "honister"
```
